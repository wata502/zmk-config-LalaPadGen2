## config/boards/shields/lalapadgen2/Kconfig.defconfig
```kconfig
if SHIELD_LALAPADGEN2_DONGLE

config ZMK_KEYBOARD_NAME
    default "LalapadGen2"

config ZMK_SPLIT_ROLE_CENTRAL
    default y

# Two peripherals: the left and right halves.
config ZMK_SPLIT_BLE_CENTRAL_PERIPHERALS
    default 2

# 2 peripherals + host BT profiles.
config BT_MAX_CONN
    default 6

config BT_MAX_PAIRED
    default 6

endif

# In the dongle setup BOTH halves are peripherals, so neither sets
# ZMK_SPLIT_ROLE_CENTRAL (it defaults to n = peripheral). The dongle above is
# the only central. (Previously the right half was the central.)

if SHIELD_LALAPADGEN2_LEFT || SHIELD_LALAPADGEN2_RIGHT || SHIELD_LALAPADGEN2_DONGLE

config ZMK_SPLIT
    default y

endif
```

## config/boards/shields/lalapadgen2/Kconfig.shield
```kconfig
config SHIELD_LALAPADGEN2_LEFT
    def_bool $(shields_list_contains,lalapadgen2_left)

config SHIELD_LALAPADGEN2_RIGHT
    def_bool $(shields_list_contains,lalapadgen2_right)

config SHIELD_LALAPADGEN2_DONGLE
    def_bool $(shields_list_contains,lalapadgen2_dongle)
```
