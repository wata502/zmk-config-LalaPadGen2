#include "lalapadgen2.dtsi"

&default_transform {
    col-offset = <6>;
};

&kscan0 {
    col-gpios
        = <&xiao_d 0 GPIO_ACTIVE_HIGH>
        , <&xiao_d 1 GPIO_ACTIVE_HIGH>
        , <&xiao_d 2 GPIO_ACTIVE_HIGH>
        , <&xiao_d 3 GPIO_ACTIVE_HIGH>
        , <&gpio0 15 GPIO_ACTIVE_HIGH>
        , <&gpio0 19 GPIO_ACTIVE_HIGH>
        ;
};

// Dongle setup: the right half is now a split PERIPHERAL. Forward its local
// trackpad to the central (dongle) over the split link via trackpad_split_R.
// The listeners that actually process trackpad data run on the dongle, not here.
&trackpad_split_R {
    status = "okay";
    device = <&iqs9151>;
};
&trackpad_split_L {
    status = "disabled";
};
